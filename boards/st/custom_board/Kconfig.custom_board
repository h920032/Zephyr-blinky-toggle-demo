## boards/st/custom_board/Kconfig.custom_board
```kconfig
# Copyright (c) 2020 Sebastian Schwabe <sebastian.schwabe@mailbox.tu-dresden.de>
# SPDX-License-Identifier: Apache-2.0

config BOARD_CUSTOM_BOARD
	select SOC_STM32F303X8
```

## boards/st/custom_board/board.yml
```yaml
board:
  name: custom_board
  full_name: Nucleo F303K8
  vendor: st
  socs:
    - name: stm32f303x8
```
